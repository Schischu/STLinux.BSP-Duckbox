## Kconfig
```kconfig
mainmenu "Configuration"

# needed to handle tristates
config MODULES
        bool
        default y

menu "Project Name & Version           "

config PROJECT
        string
        prompt "Project Name "
        help
          Name of this project; each PTXdist "Project" specifies a unique
          configuration for an embedded Linux project. A project constists
          of one directory in $(PROJECTDIR), which is usually to be found
          in $(PTXDIST_TOPDIR)/projects when being delivered with the
          PTXdist base package.

          You can specifiy an additional directory which is being searched
          for "local" projects with "make setup". The predefined path
          for local projects is $(PTXDIST_TOPDIR)/local_projects.

          To find out which projects are available in the current tree,
          type "make configs".

config PROJECT_VERSION
        string
        prompt "Project Version   "
        default "$(PTXCONF_PROJECT)-1"
        help
          The Project Version can be used to differentiate between
          several sub versions which belong ontop of one PTXdist
          version.

endmenu

menu "Project Specific Configuration   "

source "generated/project_specific.in"

endmenu

menu "PTXdist Base Configuration       "

source "rules/Kconfig"

endmenu
```
